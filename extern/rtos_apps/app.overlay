&i2c0 {
    status = "okay";

    ssd1306: ssd1306@3c {
        compatible = "solomon,ssd1306fb";
        reg = <0x3c>;

        width = <128>;
        height = <64>;

        segment-offset = <0>;
        page-offset = <0>;
        display-offset = <0>;
        multiplex-ratio = <63>;

        segment-remap;
        com-invdir;
        com-sequential;
        

        prechargep = <0x22>;
    };
};
